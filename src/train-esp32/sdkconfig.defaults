## src/train-esp32/sdkconfig.defaults
```kconfig
# Enable WiFi
CONFIG_ESP32_WIFI_STATIC_RX_BUFFER_NUM=16
CONFIG_ESP32_WIFI_DYNAMIC_RX_BUFFER_NUM=32
CONFIG_ESP32_WIFI_DYNAMIC_TX_BUFFER_NUM=32

# TCP/IP Stack
CONFIG_LWIP_MAX_SOCKETS=16
CONFIG_LWIP_SO_REUSE=y
CONFIG_LWIP_IP_MULTICAST=y

# FreeRTOS settings
CONFIG_FREERTOS_HZ=1000
```
